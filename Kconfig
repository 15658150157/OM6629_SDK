## Kconfig
```kconfig
################################################################################
## @File       Kconfig
## @Brief      SDK configuration
################################################################################

mainmenu "SDK Configuration"


#
# System
#
menu 'System'
config HARDWARE_VERSION
    int "Hardware version(A1:1; A2:2; A3:3, ...)"
    default 1
endmenu

#
# BSP
#
rsource "bsp/Kconfig"

#
# components
#
rsource "components/Kconfig"

#
# hal
#
rsource "hal/Kconfig"

#
# RTOS
#
rsource "rtos/Kconfig"
```

## bsp/Kconfig
```kconfig
menu "BSP"

choice
    prompt "Board Select"
    default BOARD_NONE

config BOARD_NONE
    bool "Non-specific board"
config BOARD_EVB
    bool "Evaluation board"
endchoice

choice
    prompt "Graphics LCD controller"
    default GLCD_NONE
    depends on BOARD_EVB

config GLCD_NONE
    bool "Non-specific GLCD"
config GLCD_GC9C01
    bool "Graphics LCD GC9C01"
config GLCD_GC9B71
    bool "Graphics LCD GC9B71"
endchoice

endmenu
```

## components/ble/Kconfig
```kconfig
menuconfig BLE
    bool "Bluetooth Low Energy Stack"
    select EVT
    select NVDS
    select PM
    default y

if BLE
    orsource "controller/Kconfig"

    config BLE_HOST
        bool "BLE Host stack"
        default y
    config BLE_MESH
        bool "BLE Mesh"
        depends on BLE_CONTROLLER
        depends on BLE_HOST
        depends on FREE_RTOS
        default n
endif
```
